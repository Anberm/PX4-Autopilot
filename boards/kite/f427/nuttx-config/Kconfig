## boards/kite/f427/nuttx-config/Kconfig
```kconfig
#
# For a description of the syntax of this configuration file,
# see misc/tools/kconfig-language.txt.
#
config BOARD_HAS_PROBES
	bool "Board provides GPIO or other Hardware for signaling to timing analyze."
	default y
	---help---
		This board provides GPIO PWM_OUT1-6 (PE14, PE13, PE11, PE9, PD13, PD14) to provide timing signals from selected drivers.

config BOARD_USE_PROBES
	bool "Enable the use the board provided PWM_OUT1-6 as PROBE_1-6"
	default n
	depends on BOARD_HAS_PROBES

	---help---
		Select to use GPIO PWM_OUT1-6 (PE9, PE11, PE13, PE14, PD13, PD14) to provide timing signals from selected drivers.
```

## boards/kite/f427/nuttx-config/bootloader/defconfig
```kconfig
# Minimal bootloader configuration
CONFIG_ARCH="arm"
CONFIG_ARCH_BOARD_CUSTOM=y
CONFIG_ARCH_BOARD_CUSTOM_DIR="../../../../boards/kite/f427/nuttx-config"
CONFIG_ARCH_CHIP="stm32"
CONFIG_ARCH_CHIP_STM32=y
CONFIG_ARCH_CHIP_STM32F427V=y
CONFIG_STM32_STM32F4XXX=y
CONFIG_ARMV7M_MEMCPY=y
CONFIG_ARMV7M_USEBASEPRI=y
CONFIG_DEFAULT_SMALL=y
CONFIG_RAW_BINARY=y
CONFIG_BUILD_FLAT=y

# Disable features not needed in bootloader
# CONFIG_BUILTIN is not set
# CONFIG_APPS_DIR is not set
# CONFIG_DISABLE_OS_API is not set
# CONFIG_INIT_ENTRYPOINT is not set
CONFIG_DISABLE_ENVIRON=y
CONFIG_DISABLE_PSEUDOFS_OPERATIONS=y
CONFIG_DISABLE_PTHREAD=y
CONFIG_DISABLE_MOUNTPOINT=y
# CONFIG_FS_PROCFS is not set
# CONFIG_FS_TMPFS is not set
# CONFIG_SCHED_INSTRUMENTATION is not set
# CONFIG_SCHED_INSTRUMENTATION_EXTERNAL is not set
# CONFIG_SCHED_INSTRUMENTATION_SWITCH is not set
# CONFIG_SCHED_WAITPID is not set
# CONFIG_PIPES is not set
# CONFIG_SERIAL_TERMIOS is not set
# CONFIG_LIBC_STRERROR is not set

# Additional bootloader specific configurations to reduce size
# CONFIG_DEBUG is not set
# CONFIG_DEBUG_ERROR is not set
# CONFIG_DEBUG_WARN is not set
# CONFIG_DEBUG_INFO is not set
# CONFIG_DEBUG_FS is not set
# CONFIG_DEBUG_GPIO is not set
# CONFIG_DEBUG_DMA is not set
# CONFIG_DEBUG_IRQ is not set
# CONFIG_DEBUG_NET is not set
# CONFIG_DEBUG_POWER is not set
# CONFIG_DEBUG_RTC is not set
# CONFIG_DEBUG_MEM is not set
# CONFIG_DEBUG_SCHED is not set
# CONFIG_DEBUG_SYSCALL is not set
# CONFIG_DEBUG_MM is not set
# CONFIG_DEBUG_SPI is not set
# CONFIG_DEBUG_UART is not set
# CONFIG_DEBUG_WATCHDOG is not set
# CONFIG_DEBUG_PWM is not set
# CONFIG_DEBUG_I2C is not set
# CONFIG_DEBUG_USB is not set
# CONFIG_DEBUG_CAN is not set
# CONFIG_DEBUG_GRAPHICS is not set
# CONFIG_DEBUG_BATTERY is not set
# CONFIG_DEBUG_LEDS is not set
# CONFIG_DEBUG_AUDIO is not set
# CONFIG_DEBUG_INPUT is not set
# CONFIG_DEBUG_WIRELESS is not set
# CONFIG_DEBUG_SENSORS is not set
# CONFIG_DEBUG_MOTOR is not set
# CONFIG_DEBUG_ANALOG is not set
# CONFIG_DEBUG_DAC is not set
# CONFIG_DEBUG_ADC is not set
# CONFIG_DEBUG_TIMER is not set
# CONFIG_DEBUG_RTC is not set
# CONFIG_DEBUG_WATCHDOG is not set
# CONFIG_DEBUG_PWM is not set
# CONFIG_DEBUG_CRC is not set
# CONFIG_DEBUG_LIB is not set
# CONFIG_DEBUG_SYSTEM is not set
# CONFIG_DEBUG_TOOLCHAIN is not set
# CONFIG_DEBUG_ARCH is not set
# CONFIG_DEBUG_BOARD is not set

# Bootloader specific configurations
CONFIG_BOARD_LOOPSPERMSEC=16717
CONFIG_MM_REGIONS=2
CONFIG_STM32_PWR=y
# CONFIG_STM32_USART2 is not set
CONFIG_USART2_BAUD=115200
CONFIG_USART2_RXBUFSIZE=64
CONFIG_USART2_TXBUFSIZE=64
# CONFIG_STM32_OTGFS is not set
# CONFIG_USBDEV is not set
# CONFIG_USBDEV_BUSPOWERED is not set
# CONFIG_STM32_RTC is not set
# CONFIG_RTC_DATETIME is not set
CONFIG_STM32_RTC_HSECLOCK=y
CONFIG_STM32_RTC_MAGIC=0xfacefeee
CONFIG_STM32_RTC_MAGIC_REG=1
CONFIG_RAM_SIZE=65536
CONFIG_RAM_START=0x20000000
CONFIG_ARCH_INTERRUPTSTACK=256
# CONFIG_DEBUG_SYMBOLS is not set
CONFIG_ARMV7M=y
CONFIG_ARCH_CORTEXM4=y
CONFIG_ARCH_FPU=y
```
